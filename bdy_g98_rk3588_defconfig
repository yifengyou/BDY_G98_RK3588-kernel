## drivers/net/ethernet/realtek/r8125_vendor/Kconfig
```kconfig
config R8125
	tristate "Realtek RTL8125 2.5GbE PCI Express support"
	depends on PCI
	select CRC32
	select MII
	default y
	help
	  This driver supports Realtek RTL8125 series 2.5 Gigabit
	  Ethernet PCI Express network adapters.

	  To compile this driver as a module, choose M here. The module
	  will be called r8125.

	  If unsure, say N.

if R8125

config R8125_SOC_LAN
	bool "Enable SoC LAN support"
	default y

config R8125_FIBER_SUPPORT
	bool "Enable Fiber (optical) support"
	default n

config R8125_REALWOW_SUPPORT
	bool "Enable RealWoW support"
	default n

config R8125_DASH_SUPPORT
	bool "Enable DASH (Desktop and mobile Architecture for System Hardware) support"
	default y

config R8125_DOWN_SPEED_100
	bool "Force link speed down to 100Mbps"
	default n

config R8125_ASPM
	bool "Enable Active State Power Management (ASPM)"
	default y

config R8125_S5WOL
	bool "Enable Wake-on-LAN at S5 (shutdown) state"
	default y

config R8125_S5_KEEP_CURR_MAC
	bool "Keep current MAC address at S5 state"
	default n

config R8125_EEE
	bool "Enable Energy Efficient Ethernet (EEE)"
	default n

config R8125_S0_MAGIC_PACKET
	bool "Enable magic packet wakeup at S0 (running) state"
	default n

config R8125_TX_NO_CLOSE
	bool "Enable TX no-close mode"
	default y

config R8125_MULTIPLE_TX_QUEUE
	bool "Enable multiple TX queues"
	default n

config R8125_PTP_SUPPORT
	bool "Enable PTP (Precision Time Protocol) hardware timestamping"
	default n

config R8125_RSS_SUPPORT
	bool "Enable Receive Side Scaling (RSS) support"
	default n

config R8125_LIB_SUPPORT
	bool "Enable auxiliary library support"
	default n

config R8125_USE_FIRMWARE_FILE
	bool "Load firmware from a firmware file"
	default n

config R8125_DISABLE_WOL_SUPPORT
	bool "Completely disable Wake-on-LAN support"
	default n

config R8125_DISABLE_MULTI_MSIX_VECTOR
	bool "Disable multiple MSI-X vectors"
	default n

config R8125_DOUBLE_VLAN
	bool "Enable double VLAN (QinQ) support"
	default n

config R8125_PAGE_REUSE
	bool "Enable RX page reuse"
	default y

config R8125_RX_PACKET_FRAGMENT
	bool "Enable RX packet fragmentation"
	default n

config R8125_GIGA_LITE
	bool "Enable Giga Lite mode"
	default y

endif # R8125
```
